## CMakeLists.txt
```
# SPDX-License-Identifier: Apache-2.0

cmake_minimum_required(VERSION 3.13.1)
find_package(Zephyr REQUIRED HINTS $ENV{ZEPHYR_BASE})
project(zephyr-demo-wifi)

FILE(GLOB app_sources src/*.c)
target_sources(app PRIVATE ${app_sources})
```

## prj.conf
```kconfig
# For all options check:
# https://docs.zephyrproject.org/latest/reference/kconfig/index-all.html

# Comment/Uncomment to have debug symbols and disable optimizations 
CONFIG_DEBUG=y
CONFIG_NO_OPTIMIZATIONS=y

CONFIG_NET_SHELL=y
CONFIG_NET_L2_WIFI_SHELL=y

CONFIG_GPIO=y
CONFIG_NETWORKING=y
CONFIG_NET_IPV4=y
CONFIG_NET_IPV6=n

CONFIG_WIFI=y
CONFIG_WIFI_LOG_LEVEL_ERR=y
CONFIG_NET_NATIVE=y
CONFIG_NET_OFFLOAD=y
CONFIG_NET_SOCKETS_POSIX_NAMES=y
```

## boards/b_l4s5i_iot01a.overlay
```dts
/*
 * Copyright (c) 2020 STMicroelectronics
 *
 * SPDX-License-Identifier: Apache-2.0
 */

/ {
	aliases {
		led1 = &green_led_2;
	};
};

&spi3 {
	cs-gpios = <&gpiod 13 (GPIO_ACTIVE_HIGH | GPIO_PULL_UP)>,<&gpioe 0 GPIO_ACTIVE_LOW>;
};
```

## src/main.c
```c
/*
 *
 *  Created on: Dec 27, 2020
 *      Author: Joao Carreira
 *
 * SPDX-License-Identifier: Apache-2.0
 */

#include "wifi_demo.h"

void main(void)
{
	Wifi_demo();
}
```

## src/config.h
```c
/*
 * config.h
 *
 *  Created on: Dec 27, 2020
 *      Author: Joao Carreira
 *
 * SPDX-License-Identifier: Apache-2.0
 */

#ifndef SRC_CONFIG_H_
#define SRC_CONFIG_H_

// Auto join 0 - Disabled, 1 - Enable
#define AUTO_CONNECT  		1

// SSID
#define AUTO_CONNECT_SSID 	"<<SSID>>"

// Password
#define AUTO_CONNECT_SSID_PSK	"<<PSK>>"

//Security type WIFI_SECURITY_TYPE_NONE = 0, WIFI_SECURITY_TYPE_PSK = 1
#define SSID_SECURITY	WIFI_SECURITY_TYPE_PSK

#endif /* SRC_CONFIG_H_ */
```

## src/wifi_demo.c
```c
/*
 * wifi_demo.c
 *
 * Base on the official sample by Intel at https://github.com/zephyrproject-rtos/zephyr/tree/master/samples/net/wifi
 *
 * Created on: Dec 27, 2020
 * Author: Joao Carreira
 *
 * SPDX-License-Identifier: Apache-2.0
 *
 */

#include <stdio.h>

#include <zephyr.h>
#include <device.h>
#include <devicetree.h>
#include <drivers/gpio.h>

#include <net/wifi.h>
#include <net/net_if.h>
#include <net/net_event.h>
#include <net/net_mgmt.h>
#include <net/wifi_mgmt.h>

#include <string.h>

#include "config.h"

#if AUTO_CONNECT
#ifndef DT_N_NODELABEL_wifi0
#error "Unsupported board: wifi0 is not defined in the devicetree"
#endif

#define perror(fmt, args...)						\
do {									\
	printf("Error: " fmt "(): %d\n" ## args, errno );	\
	while(1); \
} while (0)								\


#define WIFI_MGMT_EVENTS (NET_EVENT_WIFI_SCAN_RESULT |		\
				NET_EVENT_WIFI_SCAN_DONE |		\
				NET_EVENT_WIFI_CONNECT_RESULT |		\
				NET_EVENT_WIFI_DISCONNECT_RESULT)


static struct net_mgmt_event_callback cb;
static struct k_sem net_cb_sem;


static void Wifi_check_connect_result( struct net_if *iface, struct net_mgmt_event_callback *cb)
{
	const struct wifi_status *status = (const struct wifi_status *) cb->info;
	if (!status->status) {
		// Connected
		k_sem_give(&net_cb_sem);
	}
}


void Wifi_event_listener( struct net_mgmt_event_callback *cb, uint32_t mgmt_event, struct net_if *iface ) {
	switch( mgmt_event ) {
		case NET_EVENT_WIFI_CONNECT_RESULT:
			Wifi_check_connect_result( iface, cb );
			break;
	}
}

int Wifi_autoconnect() {
	struct wifi_connect_req_params wifi_args;
	wifi_args.security = WIFI_SECURITY_TYPE_PSK;
	wifi_args.channel = WIFI_CHANNEL_ANY;
	wifi_args.psk = AUTO_CONNECT_SSID_PSK;
	wifi_args.psk_length = strlen(AUTO_CONNECT_SSID_PSK);
	wifi_args.ssid = AUTO_CONNECT_SSID;
	wifi_args.ssid_length = strlen(AUTO_CONNECT_SSID);

	// Init semaphore
	k_sem_init(&net_cb_sem, 0, 1);

	// Configure Callback
	net_mgmt_init_event_callback(&cb, Wifi_event_listener, WIFI_MGMT_EVENTS );
	net_mgmt_add_event_callback(&cb);

	// Connect interface to network
	struct net_if *iface = net_if_get_default();
	if( net_mgmt( NET_REQUEST_WIFI_CONNECT, iface, &wifi_args, sizeof(wifi_args) ) ) {
		perror("Failed to request connection to SSID "AUTO_CONNECT_SSID);
	}

	// Wait for connection.....
	k_sem_take(&net_cb_sem, K_FOREVER );

	struct net_if_ipv4 *ipv4 = iface->config.ip.ipv4;
	static char buf[NET_IPV4_ADDR_LEN];
	net_addr_ntop( AF_INET, (const char *)&ipv4->unicast[0].address.in_addr, buf, NET_IPV4_ADDR_LEN);
	printk("\r\nSucessfull connected to SSID:["AUTO_CONNECT_SSID"]\r\nAssigned IP address [%s] \r\n", buf );

	return 0;
}
#endif

void Wifi_demo(void)
{

#if AUTO_CONNECT
	Wifi_autoconnect();
#endif

}
```

## src/wifi_demo.h
```c
/*
 * wifi_demo.h
 *
 *  Created on: Dec 27, 2020
 *      Author: Joao Carreira
 */

#ifndef SRC_WIFI_DEMO_H_
#define SRC_WIFI_DEMO_H_

// Declare demo funtion
void Wifi_demo(void);

#endif /* SRC_WIFI_DEMO_H_ */
```

## src/wifi_demo_shell.c
```c
/*
 * wifi_demo_shell.c
 *
 *  Created on: Dec 27, 2020
 *      Author: Joao Carreira
 *
 * SPDX-License-Identifier: Apache-2.0
 */

#include <zephyr.h>
#include <stdio.h>
#include <stdlib.h>
#include <shell/shell.h>
#include <sys/printk.h>
#include <init.h>
#include <fcntl.h>

#include <net/net_if.h>
#include <net/wifi_mgmt.h>
#include <net/net_event.h>
#include <net/socket.h>

#define DEMO_SHELL_MODULE "demo"

#define print(shell, level, fmt, ...)					\
	do {								\
		if (shell) {						\
			shell_fprintf(shell, level, fmt, ##__VA_ARGS__); \
		} else {						\
			printk(fmt, ##__VA_ARGS__);			\
		}							\
	} while (false)

struct cmd_connect_args {
	char *proto;
	char *address;
	uint16_t port;
};

static int __connect_args_to_params(size_t argc, char *argv[],
		struct cmd_connect_args *params)
{
	if (argc < 3) {
		return -EINVAL;
	}

	/* SSID */
	params->proto = argv[1];
	params->address = argv[2];
	params->port = atoi(argv[3]);

	return 0;
}

static int cmd_conect(const struct shell *shell, size_t argc, char *argv[])
{
	int ret = 0;
	int count;
	char c;
	struct k_poll_signal *signal;
	int set;
	int res;
	int fd;

	struct sockaddr_in addr4;
	struct cmd_connect_args params;
	__connect_args_to_params(argc, argv, &params);

	addr4.sin_family = AF_INET;
	addr4.sin_port = htons(params.port);
	inet_pton(AF_INET, INADDR_ANY, &addr4.sin_addr);

	if (strcmp(params.proto, "udp") == 0) {
		fd = socket(addr4.sin_family, SOCK_DGRAM, IPPROTO_UDP);
		if (fd < 0) {
			shell_fprintf(shell, SHELL_ERROR,
					"Failed to create socket");
		}
		ret = bind(fd, (const struct sockaddr*)&addr4, sizeof(addr4));
		if (fd < 0) {
			shell_fprintf(shell, SHELL_ERROR,
					"Failed bind socket address");
		}
	}
	else if (strcmp(params.proto, "tcp") == 0) {
		fd = socket(addr4.sin_family, SOCK_STREAM, IPPROTO_TCP);
	}
	else {
		shell_fprintf(shell, SHELL_ERROR, "Invalid protocol %s \n",
				params.proto);
		return -1;
	}

	if (fd < 0) {
		shell_fprintf(shell, SHELL_ERROR, "Failed to create socket");
	}

	// Ignore errors... probably not supported...
	fcntl(fd, F_SETFL, fcntl(fd, F_GETFL, 0) | O_NONBLOCK);

	struct sockaddr_in svr4;
	svr4.sin_family = AF_INET;
	svr4.sin_port = htons(params.port);
	inet_pton(AF_INET, params.address, &svr4.sin_addr);
	ret = connect(fd, (const struct sockaddr*)&svr4, sizeof(svr4));
	if (ret < 0) {
		shell_fprintf(shell, SHELL_ERROR,
				"Failed to connect to %s://%s:%d \n",
				params.proto, params.address, params.port);
		return -1;
	}
	shell_info(shell, "CONNECTED. Use CTRL+D to disconnect.\n");
	// Wait for shell events.. like keyboard press
	const char lf = '\n';
	while (1) {
		// Wait for shell events...
		ret = k_poll(shell->ctx->events, SHELL_SIGNAL_TXDONE,
				K_MSEC(10));

		// Flush socket buffer...
		do {
			// Clear errno
			errno = 0;
			ret = recv(fd, &c, 1, 0) != -1;
			if (ret < 0 || errno == EAGAIN) {
				break;
			}
			shell_fprintf(shell, SHELL_NORMAL, "%c", c);
		} while (1);

		signal = &shell->ctx->signals[SHELL_SIGNAL_TXDONE];
		k_poll_signal_check(signal, &set, &res);
		if (set) {
			k_poll_signal_reset(signal);
			if (ret < 0) {
				// Some error occurred.....
				break;
			}

			// Read chars...
			(void)shell->iface->api->read(shell->iface, &c,
					sizeof(c), &count);
			if (count == 0) {
				continue;
			}
			switch (c) {
			case 0x04:
				// Disconnect
				goto end;
			case '\r':
				send(fd, &lf, 1, 0);
				shell_fprintf(shell, SHELL_NORMAL, "%c", lf);
			default:
				send(fd, &c, 1, 0);
				shell_fprintf(shell, SHELL_NORMAL, "%c", c);
			}

		}
	}
	end:
	close(fd);
	shell_info(shell, "DISCONECTED\n");
	return 0;
}

//SHELL_STATIC_SUBCMD_SET_CREATE(net_commands,
//	SHELL_CMD(tcp, NULL,
//		  "Creates a connection [-p proto]  <IP> <Port>",
//		  cmd_conect),
//	SHELL_SUBCMD_SET_END
//);

SHELL_CMD_REGISTER(nc, NULL, "Connection TCP/UDP commands", cmd_conect);

static int demo_shell_init(const struct device *unused)
{
	ARG_UNUSED(unused);
	return 0;
}

SYS_INIT(demo_shell_init, APPLICATION, CONFIG_KERNEL_INIT_PRIORITY_DEFAULT);
```
